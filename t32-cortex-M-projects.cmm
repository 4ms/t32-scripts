;:::::::::::::::::::::::::::::: F7 :::::::::::::::::::::::::::::::

RESET

; SAMPLER
;DO ~/4ms/stm32/t32-stm32f7xx-flash FILE=/Users/dann/4ms/stm32/sampler-kit/build/f723/RelWithDebInfo/723-bootloader.elf CPU=STM32F723IE ; DUALPORT=1
DO ~/4ms/stm32/t32-stm32f7xx-flash FILE=/Users/dann/4ms/stm32/sampler-kit/build/f723/RelWithDebInfo/723.hex CPU=STM32F723IE ; DUALPORT=1
data.load.elf /Users/dann/4ms/stm32/sampler-kit/build/f723/RelWithDebInfo/723.elf /NoCode

; LOOPING DELAY
;DO ~/4ms/stm32/t32-stm32f7xx-flash FILE=/Users/dann/4ms/stm32/looping-delay-kit/build/f723/723-bootloader.elf CPU=STM32F723IE ; DUALPORT=1
;DO ~/4ms/stm32/t32-stm32f7xx-flash FILE=/Users/dann/4ms/stm32/looping-delay-kit/build/f723/723.hex CPU=STM32F723IE DUALPORT=1
;data.load.elf /Users/dann/4ms/stm32/looping-delay-kit/build/f723/723.elf /NoCode

; Inf Osc
;DO ~/4ms/stm32/t32-stm32f7xx-flash FILE=/Users/dann/4ms/stm32/osc-kit/build/f723/RelWithDebInfo/723.elf CPU=STM32F723IE DUALPORT=1

// STS
;DO ~/4ms/stm32/t32-stm32f4xx-flash CPU=STM32F427ZG DUALPORT=1 FILE=~/4ms/stm32/STS/build/main.hex
;data.load.elf ~/4ms/stm32/STS/build/main.elf /NoCode



SYStem.Option DUALPORT ON
ETM.ON

;Break main
Go