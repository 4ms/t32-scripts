// t32 Wed May  4 09:10:33 2022

B::

TOOLBAR   ON
STATUSBAR ON
FramePOS 7.125,1.6667,,,Maximized
WinPAGE.RESet

WinPAGE.Create P000
WinCLEAR

WinPOS 240.75 60.533 80. 4. 16. 1. W007
WinTABS 10. 10. 25.
ws.List \\main

WinPOS 0.0 66.2 120. 13. 6. 1. W004
WinTABS 32.
ws.Trace.List

WinPOS 0.0 0.0 51. 10. 0. 0. W006
ws.Register.view

WinPOS 0.0 12.333 120. 55. 16. 1. W001
WinTABS 10. 25. 25.
ws.List.auto

WinPOS 46.625 0.0 67. 7. 5. 0. W002
ws.Frame.view

WinPOS 107.25 39.933 115. 46. 0. 0. W005
ws.Var.Ref

WinPOS 107.25 11.6 115. 26. 0. 0. W003
ws.Var.Watch


WinPOS 107.25 0.0 115. 7. 26. 1. W008
WinTABS 13. 16. 0. 0. 0. 0. 0. 0. 0. 45.
ws.Break.List

WinPOS 240.63 70.667 88. 8. 0. 0. W000
CD.PEDIT /Users/design/4ms/stm32/meta-module/firmware/LOCAL/mm-a7-t32.cmm

WinPAGE.select P000

MENU.Reprogram
(
ADD
  MENU
  (
    POPUP "Custom"
    (
      MENUITEM "ProgAndRunMP1A7,F11" "Run /Users/design/4ms/stm32/meta-module/firmware/LOCAL/mm-a7-t32.cmm"
    )
  )
)
ENDDO
